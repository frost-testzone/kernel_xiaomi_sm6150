/*
 * Copyright (C) 2020-2025 The LineageOS Project
 *
 * this file is for attribution only of violet
 * And public attribution of Xiaomi platforms (like F7B and so)
 */

&qupv3_se6_spi {
    status = "ok";
    irled@1 {
        compatible = "ir-spi-led";
        reg = <1>; /* Chip select 0 */

        duty-cycle = <30>;
        spi-max-frequency = <1000000>;
    };
};
